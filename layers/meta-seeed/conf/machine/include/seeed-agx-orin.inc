## layers/meta-seeed/conf/machine/include/seeed-agx-orin.inc
```bitbake
PREFERRED_PROVIDER_virtual/dtb = "seeed-devicetree"
IMAGE_CLASSES:append = " seeed-recomputer-super-tegraflash"

TEGRA_BOARDID ?= "3701"
SEEED_MODULE_SKU ?= "${SEEED_DEFAULT_MODULE_SKU}"
SEEED_MODULE_DTB_SKU_MAP ?= "0000:0000 0001:0000 0002:0000 0004:0004 0005:0005"
SEEED_MODULE_BPMP_SKU_MAP ?= "${SEEED_MODULE_DTB_SKU_MAP}"

def seeed_module_sku_map(d, mapvar):
    entries = (d.getVar(mapvar) or "").split()
    mapping = dict(entry.split(":", 1) for entry in entries)
    return mapping.get(d.getVar("SEEED_MODULE_SKU"), "")

SEEED_MODULE_DTB_SKU = "${@seeed_module_sku_map(d, 'SEEED_MODULE_DTB_SKU_MAP')}"
SEEED_MODULE_BPMP_SKU = "${@seeed_module_sku_map(d, 'SEEED_MODULE_BPMP_SKU_MAP')}"

python () {
    sku = d.getVar("SEEED_MODULE_SKU")
    supported = (d.getVar("SEEED_SUPPORTED_MODULE_SKUS") or "").split()
    if not sku:
        bb.fatal("SEEED_MODULE_SKU is not configured for %s" % d.getVar("MACHINE"))
    if sku not in supported:
        bb.fatal("Unsupported SEEED_MODULE_SKU %s for %s; supported values: %s" %
                 (sku, d.getVar("MACHINE"), " ".join(supported)))
    if not d.getVar("SEEED_MODULE_DTB_SKU") or not d.getVar("SEEED_MODULE_BPMP_SKU"):
        bb.fatal("Missing DTB/BPMP mapping for SEEED_MODULE_SKU %s" % sku)
}

TEGRA_BOARDSKU = "${SEEED_MODULE_SKU}"
TEGRA_FLASHVAR_BPFDTB_FILE = "tegra234-bpmp-3701-${SEEED_MODULE_BPMP_SKU}-3737-0000.dtb"
TEGRA_FLASHVAR_ODMDATA = "gbe-uphy-config-22,nvhs-uphy-config-0,hsio-uphy-config-16,gbe0-enable-10g,hsstp-lane-map-3"
TEGRA_FLASHVAR_PINMUX_CONFIG = "${SEEED_PINMUX_CONFIG}"
TEGRA_FLASHVAR_PMC_CONFIG = "${SEEED_PMC_CONFIG}"
KERNEL_DEVICETREE = "${SEEED_DTB}"

TEGRA_PLUGIN_MANAGER_OVERLAYS = "L4TConfiguration.dtbo tegra234-carveouts.dtbo tegra-optee.dtbo ${SEEED_OVERLAYS}"
TEGRA_FLASHVAR_DCE_OVERLAY = "${SEEED_DCE_OVERLAY}"
```

## layers/meta-seeed/conf/machine/include/seeed-orin-j401.inc
```bitbake
PREFERRED_PROVIDER_virtual/dtb = "seeed-devicetree"
IMAGE_CLASSES:append = " seeed-recomputer-super-tegraflash"

TEGRA_FLASHVAR_ODMDATA ?= "gbe-uphy-config-9,hsstp-lane-map-3,hsio-uphy-config-0"
TEGRA_FLASHVAR_PINMUX_CONFIG = "${SEEED_PINMUX_CONFIG}"
TEGRA_FLASHVAR_PMC_CONFIG = "${SEEED_PMC_CONFIG}"
KERNEL_DEVICETREE = "${SEEED_DTB}"

TEGRA_PLUGIN_MANAGER_OVERLAYS:append = " ${SEEED_OVERLAYS}"
TEGRA_FLASHVAR_DCE_OVERLAY = "${SEEED_DCE_OVERLAY}"
```

## layers/meta-seeed/conf/machine/include/seeed-thor.inc
```bitbake
PREFERRED_PROVIDER_virtual/dtb = "seeed-devicetree"
IMAGE_CLASSES:append = " seeed-recomputer-super-tegraflash"

TEGRA_FLASHVAR_BPFDTB_FILE = "${SEEED_BPFDTB}"
TEGRA_FLASHVAR_BPF_FILE = "${SEEED_BPFFILE}"
TEGRA_FLASHVAR_PINMUX_CONFIG = "${SEEED_PINMUX_CONFIG}"
TEGRA_FLASHVAR_PMC_CONFIG = "${SEEED_PMC_CONFIG}"
TEGRA_FLASHVAR_MISC_CONFIG = "${SEEED_MISC_CONFIG}"
TEGRA_FLASHVAR_PMIC_CONFIG = "${SEEED_PMIC_CONFIG}"
TEGRA_FLASHVAR_WB0SDRAM_BCT = "${SEEED_WB0SDRAM_BCT}"
TEGRA_FLASHVAR_BPMP_MEM_CONFIG = "${SEEED_BPMP_MEM_CONFIG}"
KERNEL_DEVICETREE = "${SEEED_DTB}"
EMC_BCT = "${SEEED_EMC_BCT}"
TEGRA_PLUGIN_MANAGER_OVERLAYS:append = " ${SEEED_OVERLAYS}"
```

## layers/meta-seeed/conf/machine/recomputer-industrial-orin-j401.conf
```bitbake
#@TYPE: Machine
#@NAME: Seeed reComputer Industrial J401

MACHINEOVERRIDES =. "p3768-0000-p3767-0000:"
require conf/machine/p3768-0000-p3767-0000.conf
require conf/machine/include/seeed-orin-j401.inc

SEEED_DTB = "tegra234-j201-p3768-0000+p3767-0000-recomputer-indu.dtb"
SEEED_PINMUX_CONFIG = "recomputer-indu-orin-j201-bct-pinmux-p3767-0000.dtsi"
SEEED_PMC_CONFIG = "recomputer-indu-orin-j201-bct-padvoltage-default-p3767-0000.dtsi"
SEEED_DCE_OVERLAY = "tegra234-dcb-p3767-0000-hdmi.dtbo"
SEEED_OVERLAYS = "tegra234-dcb-p3767-0000-hdmi.dtbo"
```

## layers/meta-seeed/conf/machine/recomputer-orin-j401.conf
```bitbake
#@TYPE: Machine
#@NAME: Seeed reComputer J401

MACHINEOVERRIDES =. "p3768-0000-p3767-0000:"
require conf/machine/p3768-0000-p3767-0000.conf
require conf/machine/include/seeed-orin-j401.inc

SEEED_DTB = "tegra234-j401-p3768-0000+p3767-0000-recomputer.dtb"
SEEED_PINMUX_CONFIG = "tegra234-mb1-bct-pinmux-p3767-hdmi-a03.dtsi"
SEEED_PMC_CONFIG = "tegra234-mb1-bct-padvoltage-p3767-hdmi-a03.dtsi"
SEEED_DCE_OVERLAY = "tegra234-dcb-p3767-0000-hdmi.dtbo"
SEEED_OVERLAYS = "tegra234-dcb-p3767-0000-hdmi.dtbo"
```

## layers/meta-seeed/conf/machine/recomputer-orin-j40mini.conf
```bitbake
#@TYPE: Machine
#@NAME: Seeed reComputer J40 Mini

MACHINEOVERRIDES =. "p3768-0000-p3767-0000:"
require conf/machine/p3768-0000-p3767-0000.conf
require conf/machine/include/seeed-orin-j401.inc

SEEED_DTB = "tegra234-j40mini-p3768-0000+p3767-0000-recomputer.dtb"
SEEED_PINMUX_CONFIG = "recomputer-mini-orin-j40-pinmux-p3767-0000.dtsi"
SEEED_PMC_CONFIG = "recomputer-mini-orin-j40-padvoltage-p3767-0000.dtsi"
SEEED_DCE_OVERLAY = ""
SEEED_OVERLAYS = ""
```

## layers/meta-seeed/conf/machine/recomputer-orin-robotics-j401-gmsl.conf
```bitbake
#@TYPE: Machine
#@NAME: Seeed reComputer Robotics J401 GMSL

MACHINEOVERRIDES =. "p3768-0000-p3767-0000:"
require conf/machine/p3768-0000-p3767-0000.conf
require conf/machine/include/seeed-orin-j401.inc

SEEED_DTB = "tegra234-j401-p3768-0000+p3767-0000-recomputer-robo-gmsl.dtb"
SEEED_PINMUX_CONFIG = "recomputer-robotics-orin-j40-pinmux-p3767-0000.dtsi"
SEEED_PMC_CONFIG = "recomputer-robotics-orin-j40-padvoltage-p3767-0000.dtsi"
SEEED_DCE_OVERLAY = ""
SEEED_OVERLAYS = "tegra234-seeed-gmsl-recomputer-robo-3g-overlay.dtbo tegra234-seeed-gmsl-recomputer-robo-6g-overlay.dtbo"
```

## layers/meta-seeed/conf/machine/recomputer-orin-robotics-j401.conf
```bitbake
#@TYPE: Machine
#@NAME: Seeed reComputer Robotics J401

MACHINEOVERRIDES =. "p3768-0000-p3767-0000:"
require conf/machine/p3768-0000-p3767-0000.conf
require conf/machine/include/seeed-orin-j401.inc

SEEED_DTB = "tegra234-j401-p3768-0000+p3767-0000-recomputer-robo.dtb"
SEEED_PINMUX_CONFIG = "recomputer-robotics-orin-j40-pinmux-p3767-0000.dtsi"
SEEED_PMC_CONFIG = "recomputer-robotics-orin-j40-padvoltage-p3767-0000.dtsi"
SEEED_DCE_OVERLAY = ""
SEEED_OVERLAYS = ""
```

## layers/meta-seeed/conf/machine/recomputer-orin-super-j401.conf
```bitbake
#@TYPE: Machine
#@NAME: Seeed reComputer Super J401

MACHINEOVERRIDES =. "p3768-0000-p3767-0000:"
require conf/machine/p3768-0000-p3767-0000.conf
require conf/machine/include/seeed-orin-j401.inc

SEEED_DTB = "tegra234-j401-p3768-0000+p3767-0000-recomputer-super.dtb"
SEEED_PINMUX_CONFIG = "recomputer-super-orin-j401-pinmux-p3767-hdmi-a03.dtsi"
SEEED_PMC_CONFIG = "recomputer-super-orin-j401-padvoltage-p3767-hdmi-a03.dtsi"
SEEED_DCE_OVERLAY = "tegra234-dcb-p3767-0000-hdmi.dtbo"
SEEED_OVERLAYS = "tegra234-dcb-p3767-0000-hdmi.dtbo tegra234-p3767-camera-p3768-imx219-quad-seeed.dtbo"
```

## layers/meta-seeed/conf/machine/recomputer-robo-agx-orin-j501x.conf
```bitbake
#@TYPE: Machine
#@NAME: Seeed reComputer Robo AGX Orin J501X

require conf/machine/include/agx-orin.inc
require conf/machine/include/seeed-agx-orin.inc

SEEED_DTB = "tegra234-j501x-0000+p3701-0000-recomputer-robo.dtb"
SEEED_PINMUX_CONFIG = "recomputer-robotics-agx-orin-j501x-pinmux.dtsi"
SEEED_PMC_CONFIG = "recomputer-robotics-agx-orin-j501x-padvoltage-default.dtsi"
SEEED_DCE_OVERLAY = "tegra234-dcb-p3701-0000-hdmi.dtbo"
SEEED_OVERLAYS = "tegra234-dcb-p3701-0000-hdmi.dtbo"

TEGRA_FLASHVAR_ODMDATA = "gbe-uphy-config-22,nvhs-uphy-config-0,hsio-uphy-config-16,gbe0-enable-10g,hsstp-lane-map-3"
```

## layers/meta-seeed/conf/machine/recomputer-rugged-orin-j401.conf
```bitbake
#@TYPE: Machine
#@NAME: Seeed reComputer Rugged J401

MACHINEOVERRIDES =. "p3768-0000-p3767-0000:"
require conf/machine/p3768-0000-p3767-0000.conf
require conf/machine/include/seeed-orin-j401.inc

SEEED_DTB = "tegra234-j401-p3768-0000+p3767-0000-recomputer-rugged.dtb"
SEEED_PINMUX_CONFIG = "recomputer-rugged-orin-j401-bct-pinmux-p3767-0000.dtsi"
SEEED_PMC_CONFIG = "recomputer-rugged-orin-j401-bct-padvoltage-default-p3767-0000.dtsi"
SEEED_DCE_OVERLAY = "tegra234-dcb-p3767-0000-hdmi.dtbo"
SEEED_OVERLAYS = "tegra234-dcb-p3767-0000-hdmi.dtbo"
```

## layers/meta-seeed/conf/machine/recomputer-thor-carrier-j6014.conf
```bitbake
#@TYPE: Machine
#@NAME: Seeed reComputer Thor Carrier J6014

require conf/machine/include/agx-thor-t4000.inc
require conf/machine/include/seeed-thor.inc

SEEED_DTB = "tegra264-p4071-0000+p3834-0000-recomputer-carrier.dtb"
SEEED_BPFDTB = "tegra264-bpmp-3834-0000-4071-xxxx.dtb"
SEEED_BPFFILE = "bpmp_t264-TE1070M-A1_prod.bin"
SEEED_PINMUX_CONFIG = "recomputer-thor-carrier-j601-pinmux.dts"
SEEED_PMC_CONFIG = "recomputer-thor-carrier-j601-padvoltage-default.dts"
SEEED_MISC_CONFIG = "tegra264-mb1-bct-misc-p3834-0000-p4071-0000.dts"
SEEED_PMIC_CONFIG = "tegra264-mb1-bct-pmic-p3834-0000-p4071-0000.dts"
SEEED_WB0SDRAM_BCT = "tegra264-p3834-0000-sdram-bct-warmboot-l4t.dts"
SEEED_BPMP_MEM_CONFIG = "tegra264-p3834-0000-sdram-dfs.dts"
SEEED_EMC_BCT = "tegra264-p3834-0000-sdram-bct-l4t.dts"
SEEED_OVERLAYS = ""
TEGRA_FLASHVAR_RAMCODE = "0"
```

## layers/meta-seeed/conf/machine/recomputer-thor-carrier-j6015.conf
```bitbake
#@TYPE: Machine
#@NAME: Seeed reComputer Thor Carrier J6015

require conf/machine/include/agx-thor-t5000.inc
require conf/machine/include/seeed-thor.inc

SEEED_DTB = "tegra264-p4071-0000+p3834-0008-recomputer-carrier.dtb"
SEEED_BPFDTB = "tegra264-bpmp-3834-0008-4071-xxxx.dtb"
SEEED_BPFFILE = "bpmp_t264-TA1090SA-A1_prod.bin"
SEEED_PINMUX_CONFIG = "recomputer-thor-carrier-j601-pinmux.dts"
SEEED_PMC_CONFIG = "recomputer-thor-carrier-j601-padvoltage-default.dts"
SEEED_MISC_CONFIG = "tegra264-mb1-bct-misc-p3834-0008-p4071-0000.dts"
SEEED_PMIC_CONFIG = "tegra264-mb1-bct-pmic-p3834-0008-p4071-0000.dts"
SEEED_WB0SDRAM_BCT = "tegra264-p3834-0008-sdram-bct-warmboot-l4t.dts"
SEEED_BPMP_MEM_CONFIG = "tegra264-p3834-0008-sdram-dfs.dts"
SEEED_EMC_BCT = "tegra264-p3834-0008-sdram-bct-l4t.dts"
SEEED_OVERLAYS = "tegra264-p4071-0000+p3834-xxxx-dynamic.dtbo"
```

## layers/meta-seeed/conf/machine/reserver-agx-orin-j501x-gmsl.conf
```bitbake
#@TYPE: Machine
#@NAME: Seeed reServer AGX Orin J501X GMSL

require conf/machine/include/agx-orin.inc
require conf/machine/include/seeed-agx-orin.inc

SEEED_DTB = "tegra234-j501x-0000+p3701-0000-reserver-gmsl.dtb"
SEEED_PINMUX_CONFIG = "reserver-agx-orin-j501x-mb1-bct-pinmux-p3701-0000.dtsi"
SEEED_PMC_CONFIG = "reserver-agx-orin-j501x-mb1-bct-padvoltage-p3701-0000.dtsi"
SEEED_DCE_OVERLAY = "tegra234-dcb-p3701-0000-hdmi.dtbo"
SEEED_OVERLAYS = "tegra234-dcb-p3701-0000-hdmi.dtbo"
```

## layers/meta-seeed/conf/machine/reserver-agx-orin-j501x.conf
```bitbake
#@TYPE: Machine
#@NAME: Seeed reServer AGX Orin J501X

require conf/machine/include/agx-orin.inc
require conf/machine/include/seeed-agx-orin.inc

SEEED_DEFAULT_MODULE_SKU = "0000"
SEEED_SUPPORTED_MODULE_SKUS = "0000 0001 0002 0004 0005"
SEEED_DTB = "tegra234-j501x-0000+p3701-${SEEED_MODULE_DTB_SKU}-reserver.dtb"
SEEED_PINMUX_CONFIG = "reserver-agx-orin-j501x-mb1-bct-pinmux-p3701-0000.dtsi"
SEEED_PMC_CONFIG = "reserver-agx-orin-j501x-mb1-bct-padvoltage-p3701-0000.dtsi"
SEEED_DCE_OVERLAY = "tegra234-dcb-p3701-0000-hdmi.dtbo"
SEEED_OVERLAYS = "tegra234-p3737-0000+p3701-0000-dynamic.dtbo tegra234-dcb-p3701-0000-hdmi.dtbo"
```

## layers/meta-seeed/conf/machine/seeed-agx-orin-kit.conf
```bitbake
#@TYPE: Machine
#@NAME: Seeed AGX Orin 64GB Kit

require conf/machine/include/agx-orin.inc
require conf/machine/include/seeed-agx-orin.inc

SEEED_DEFAULT_MODULE_SKU = "0000"
SEEED_SUPPORTED_MODULE_SKUS = "0000 0001 0002 0004 0005"
SEEED_DTB = "tegra234-p3737-0000+p3701-${SEEED_MODULE_DTB_SKU}-seeed.dtb"
SEEED_PINMUX_CONFIG = "seeed-agx-orin-kit-mb1-bct-pinmux-p3701-0000.dtsi"
SEEED_PMC_CONFIG = "seeed-agx-orin-kit-mb1-bct-padvoltage-p3701-0000.dtsi"
SEEED_DCE_OVERLAY = ""
SEEED_OVERLAYS = ""
```
